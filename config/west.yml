## config/west.yml
```yaml
manifest:
  remotes:
    - name: zmkfirmware
      url-base: https://github.com/zmkfirmware
    - name: urob
      url-base: https://github.com/urob
    - name: englmaxi
      url-base: https://github.com/englmaxi
  projects:
    - name: zmk
      remote: zmkfirmware
      revision: v0.3
      import: app/west.yml
    - name: zmk-helpers
      remote: urob
      revision: v0.3
    - name: zmk-dongle-display
      remote: englmaxi
      revision: v0.3 # use 'v0.3' instead of 'main' if you use have pinned zmk to 'v0.3' or below
  self:
    path: config
```
